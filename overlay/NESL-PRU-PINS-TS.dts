/*
 * Copyright (c) Regents of the University of California, 2017. All rights reserved.
 * See LICENSE and ATTRIB in the repository root.
 */

/dts-v1/;
/plugin/;

/ {
   compatible = "ti,beaglebone", "ti,beaglebone-black";

   part-number = "NESL-PRU-PINS-TS";
   version = "00A0";

   exclusive-use =
       "P8.45", "P8.46", "pru1", "pruss";

   fragment@0 {  
    target = <&am33xx_pinmux>;  
    __overlay__ {  
      example_pins: pinmux_pru_pru_pins {
	pinctrl-single,pins = <  
         0xa0 0x26  /* P8.45 PRU1 Input */
         0xa4 0x05  /* P8.46 PRU1 Output */
       >;  
      };  
    };  
   }; 
  
   fragment@1 {  
    target = <&pruss>;  
    __overlay__ {  
      status = "okay";  
      pinctrl-names = "default";  
      pinctrl-0 = <&example_pins>;  
    };  
   }; 
};
